## samples/hbridge/Kconfig
```kconfig
config NXPCUP_DIRECTION_SAMPLE
	bool "NXPCUP direction sample"
	default y
	help
	  Set to y if the hbridge sample should demonstrate how to change
	  the car's direction (forward or backwards). If set to n, the
	  sample will demonstrate how to change the car's power.

source "Kconfig.zephyr"
```

## samples/pixy2/Kconfig
```kconfig
config NXPCUP_PIXY2_I2C_TRANSPORT
	bool "Use I2C as the underlying transport protocol"
	default y
	help
	  Set to y if you wish to use I2C to communicate with the Pixy2
	  camera.

config NXPCUP_PIXY2_SPI_TRANSPORT
	bool "Use SPI as the underlying transport protocol"
	help
	  Set to y if you wish to use SPI to communicate with the Pixy2
	  camera.

source "Kconfig.zephyr"
```

## src/Kconfig
```kconfig
# TODO: add your configurations here if need be

# mandatory, includes all of the Zephyr stuff
source "Kconfig.zephyr"
```

## west.yml
```yaml
manifest:
  version: "0.13"

  remotes:
    - name: zephyrproject
      url-base: https://github.com/nxp-upstream

  projects:
    - name: zephyr
      remote: zephyrproject
      revision: nxpcup-2026
      import:
        name-whitelist:
          - hal_nxp
```
